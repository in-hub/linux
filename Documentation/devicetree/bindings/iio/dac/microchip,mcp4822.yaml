## Documentation/devicetree/bindings/iio/dac/microchip,mcp4822.yaml
```yaml
# SPDX-License-Identifier: (GPL-2.0 OR BSD-2-Clause)
%YAML 1.2
---
$id: http://devicetree.org/schemas/iio/dac/microchip,mcp4822.yaml#
$schema: http://devicetree.org/meta-schemas/core.yaml#

title: Microchip MCP4801, MCP4802, MCP4811, MCP4812, MCP4821 and MCP4822 SPI DACs

maintainers:
  - Nicolas Frattaroli <frattaroli.nicolas@gmail.com>

properties:
  compatible:
    enum:
      - microchip,mcp4801
      - microchip,mcp4802
      - microchip,mcp4811
      - microchip,mcp4812
      - microchip,mcp4821
      - microchip,mcp4822

  reg:
    maxItems: 1

  vdd-supply: true

required:
  - compatible
  - reg
  - vdd-supply

allOf:
  - $ref: /schemas/spi/spi-peripheral-props.yaml#

unevaluatedProperties: false

examples:
  - |
    spi {
        #address-cells = <1>;
        #size-cells = <0>;

        dac@0 {
            compatible = "microchip,mcp4821";
            reg = <0>;
            vdd-supply = <&dac_reg>;
        };
    };
...
```

## drivers/net/wireless/realtek/rtl8812au/Kconfig
```kconfig
# SPDX-License-Identifier: GPL-2.0-only
#
# RTL8812AU Wireless LAN device configuration
#
config RTL8812AU
	tristate "Realtek 8812AU driver"
	depends on MAC80211 && USB
	---help---
	  This is a driver for RTL8812AU based cards.

if RTL8812AU
config RTL8812A
	bool "Realtek RTL8812A support"
	---help---
	  Include support for RTL8812A devices.

config RTL8814A
	bool "Realtek RTL8814A support"
	---help---
	  Include support for RTL8814A devices.

config RTL8821A
	bool "Realtek RTL8821A support"
	---help---
	  Include support for RTL8821A devices.
endif
```
