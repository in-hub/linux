// SPDX-License-Identifier: GPL-2.0-only
/*
 * Copyright 2026 in.hub GmbH
 */

#include "imx6ull-inhub.dtsi"

/ {
	aliases {
		mmc0 = &usdhc2;
	};
};

/delete-node/ &gpmi;

&iomuxc {
	/delete-node/ gpmigpiogrp;
	/delete-node/ gpminandgrp;
	/delete-node/ usdhc2grp;
};

&usdhc2 {
	pinctrl-names = "default";
	pinctrl-0 = <&pinctrl_usdhc2emmc>;
	assigned-clocks = <&clks IMX6UL_CLK_USDHC2_SEL>, <&clks IMX6UL_CLK_USDHC2>;
	assigned-clock-parents = <&clks IMX6UL_CLK_PLL2_PFD2>;
	assigned-clock-rates = <0>, <198000000>;
	bus-width = <8>;
	keep-power-in-suspend;
	no-1-8-v;
	non-removable;
	vmmc-supply = <&reg_module_3v3>;
	status = "okay";
};
